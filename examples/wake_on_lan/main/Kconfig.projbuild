## examples/wake_on_lan/main/Kconfig.projbuild
```kconfig
menu "Wake-on-LAN Configuration"

    config WOL_TARGET_MAC
        string "Default Target MAC Address"
        default "00:11:22:33:44:55"
        help
            The MAC address of the default machine you wish to wake up, in form AA:BB:CC:DD:EE:FF.

    config WOL_UDP_PORT
        int "UDP Listener Port on Tailscale"
        default 9000
        help
            Port to listen on for incoming UDP trigger messages.

    config WOL_STATIC_IP_ENABLED
        bool "Enable Static Local IP"
        help
            Enable static local IP address instead of DHCP.

    config WOL_STATIC_IP
        string "Static Local IP Address"
        depends on WOL_STATIC_IP_ENABLED
        default "192.168.1.150"
        help
            The static IP address to assign to the ESP32 (e.g. 192.168.1.150).

    config WOL_STATIC_GATEWAY
        string "Gateway IP Address"
        depends on WOL_STATIC_IP_ENABLED
        default "192.168.1.1"
        help
            The gateway IP address (usually your router's IP, e.g. 192.168.1.1).

    config WOL_STATIC_NETMASK
        string "Subnet Netmask"
        depends on WOL_STATIC_IP_ENABLED
        default "255.255.255.0"
        help
            The netmask for the network subnet (usually 255.255.255.0).

    config WOL_LED_STRIP_ENABLED
        bool "Enable LED Strip capture for HyperHDR (UDPRAW)"
        help
            Enable capture of raw UDP packets to drive WS2812B LEDs.

    config WOL_LED_STRIP_GPIO
        int "LED Strip GPIO Pin"
        depends on WOL_LED_STRIP_ENABLED
        default 18
        help
            GPIO pin connected to the DI (Data Input) of the WS2812B LED strip.

    config WOL_LED_STRIP_NUM
        int "Number of LEDs"
        depends on WOL_LED_STRIP_ENABLED
        default 30
        help
            Number of addressable LEDs on the WS2812B strip.

    config WOL_LED_UDP_PORT
        int "UDPRAW Capture Port"
        depends on WOL_LED_STRIP_ENABLED
        default 19446
        help
            UDP port to listen on for raw RGB pixel data from HyperHDR (default is 19446).

    config WOL_LED_DDP_PORT
        int "DDP Protocol Port"
        depends on WOL_LED_STRIP_ENABLED
        default 4048
        help
            UDP port for DDP (Distributed Display Protocol) used by WLED. Default is 4048.

endmenu
```
